// generated by mBlock5 for <your product>
// codes make you happy

#include <Arduino.h>
#include <Wire.h>
#include <SoftwareSerial.h>

void _delay(float seconds) {
  long endTime = millis() + seconds * 1000;
  while(millis() < endTime) _loop();
}

void setup() {
  pinMode(5,OUTPUT);
  pinMode(7,OUTPUT);
  pinMode(6,OUTPUT);
  while(1) {
      tone(5,784,0.25*1000);
      delay(0.25*1000);
      for(int count3=0;count3<5;count3++){
        digitalWrite(7,1);
        _delay(0.075);
        digitalWrite(7,0);
        _delay(0.025);
      }
      tone(5,880,0.25*1000);
      delay(0.25*1000);
      for(int count4=0;count4<5;count4++){
        digitalWrite(6,1);
        _delay(0.075);
        digitalWrite(6,0);
        _delay(0.025);
      }

      _loop();
  }

}

void _loop() {
}

void loop() {
  _loop();
}