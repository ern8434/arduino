// generated by mBlock5 for <your product>
// codes make you happy

#include <Arduino.h>
#include <Wire.h>
#include <SoftwareSerial.h>
#include <Servo.h>

float servo = 0;

Servo servo_13;

void _delay(float seconds) {
  long endTime = millis() + seconds * 1000;
  while(millis() < endTime) _loop();
}

void setup() {
  servo_13.attach(13);
  while(1) {
      servo = 0;
      for(int count3=0;count3<180;count3++){
        servo_13.write(servo);
        servo += 1;
        _delay(0.01);
      }
      for(int count4=0;count4<180;count4++){
        servo_13.write(servo);
        servo += -1;
        _delay(0.01);
      }

      _loop();
  }

}

void _loop() {
}

void loop() {
  _loop();
}